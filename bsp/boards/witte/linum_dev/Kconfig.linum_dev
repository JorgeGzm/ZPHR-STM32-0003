## bsp/boards/witte/linum_dev/Kconfig.linum_dev
```kconfig
# Copyright (c) 2024 Felipe Neves
# SPDX-License-Identifier: Apache-2.0

config BOARD_LINUM_DEV
	select SOC_STM32H753XX
```

## bsp/boards/witte/linum_dev/board.yml
```yaml
board:
  name: linum_dev
  full_name: Linum dev Board
  vendor: witte
  socs:
    - name: stm32h753xx
```
