## CMakeLists.txt
```
# SPDX-License-Identifier: Apache-2.0
# set(BOARD_ROOT ${CMAKE_CURRENT_LIST_DIR}/linum)
# set(DTS_ROOT ${CMAKE_CURRENT_LIST_DIR}/linum)

cmake_minimum_required(VERSION 3.20.0)

# include zephyr
find_package(Zephyr REQUIRED HINTS $ENV{ZEPHYR_BASE})

# set the project name
project(ZPHR-STM32-0003)

#add all the source files to the build
file(GLOB src src/*.c)
target_sources(app PRIVATE ${src})
```

## Kconfig
```
#
# Zephyr configuration options
# Source the Kconfig.zephyr in the Zephyr root directory.
# Check out the docs: https://docs.zephyrproject.org/latest/develop/application/index.html#application-cmakelists-txt
#
menu "Witte-Tecnology"
config MQTT_SERVICE_SERVER_DOMAIN_NAME
	string "MQTT broker domain name"
	default "localhost"
	help
		MQTT server (broker) domain name.

config MQTT_SERVICE_SERVER_FALLBACK_IP_ADDRESS
	string "MQTT broker fallback IP address"
	default "127.0.0.1"
	help
		MQTT server (broker) IP address which will be used
		as fallback if DNS lookup fails. Take care that correct
		IP protocol address format is used.
		For example, IPv4 address should look like:

		127.0.0.1

config MQTT_SERVICE_SERVER_PORT
	int "MQTT broker port"
	default 1883
	help
		Port on which MQTT broker expects MQTT requests.
		Default port for unencrypted MQTT transport is 1833.
		Default port for encrypted MQTT through TLS transport is 8883.

config MQTT_DEVICE_NAME
	string "MQTT device name"
	default "esp32"
	help
		MQTT device name.

        config MQTT_SERVICE_THREAD_STACK_SIZE
	int "MQTT service thread stack size"
	default 3072
	help
		Stack size used by internal mqtt polling thread.

config MQTT_SERVICE_RX_BUFFER_SIZE
	int "MQTT RX buffer size"
	default 256
	help
		MQTT RX buffer size in bytes.

config MQTT_SERVICE_TX_BUFFER_SIZE
	int "MQTT TX buffer size"
	default 256
	help
		MQTT TX buffer size in bytes.

config MQTT_SERVICE_PAYLOAD_BUFFER_SIZE
	int "MQTT payload buffer size"
	default 1024
	help
		MQTT payload buffer is used for receiving large payload data. This buffer
		is usually used to store data from MQTT_EVT_PUBLISH events.
        
# Logging subsystem configuration:
module = MQTT_SERVICE
module-str = mqtt_service
source "subsys/logging/Kconfig.template.log_config"

endmenu

menu "Zephyr Kernel"
source "Kconfig.zephyr"
endmenu
```

## prj.conf
```kconfig
CONFIG_MAIN_STACK_SIZE=6144
CONFIG_I2C=y
CONFIG_SPI=y
CONFIG_SERIAL=y
CONFIG_SENSOR=y
CONFIG_CRC=y
CONFIG_PRINTK=y
CONFIG_CBPRINTF_FP_SUPPORT=y
CONFIG_HWINFO=y


# WIFI (ENTENDER MELHOR ROTINAS)
# CONFIG_NETWORKING=y
# CONFIG_TEST_RANDOM_GENERATOR=y

# CONFIG_NET_TX_STACK_SIZE=2048
# CONFIG_NET_RX_STACK_SIZE=2048

# CONFIG_NET_PKT_RX_COUNT=10
# CONFIG_NET_PKT_TX_COUNT=10
# CONFIG_NET_BUF_RX_COUNT=20
# CONFIG_NET_BUF_TX_COUNT=20
# CONFIG_NET_MAX_CONTEXTS=10

# CONFIG_NET_IPV4=y
# CONFIG_NET_IPV6=n
# CONFIG_NET_TCP=y
# CONFIG_NET_DHCPV4=y
# CONFIG_NET_LOG=n
# CONFIG_NET_SHELL=y
# CONFIG_NET_STATISTICS=y
# CONFIG_NET_STATISTICS_PERIODIC_OUTPUT=n
# # Numero de eventos que a lib pode gerar, isso afeta ao listar as redes wifi encontradas
# CONFIG_NET_MGMT_EVENT_QUEUE_SIZE=20

# CONFIG_INIT_STACKS=y

# CONFIG_WIFI=y
# CONFIG_WIFI_LOG_LEVEL_ERR=n
# CONFIG_NET_L2_WIFI_SHELL=n
# CONFIG_NET_L2_ETHERNET=y

# # Sockets
# CONFIG_NET_SOCKETS=y
# # CONFIG_NET_SOCKETS_POSIX_NAMES=y
# CONFIG_NET_SOCKETS_POLL_MAX=4
# CONFIG_NET_SOCKETS_LOG_LEVEL_DBG=n
# CONFIG_NET_VLAN=y
# CONFIG_DNS_RESOLVER=y
# CONFIG_NET_VLAN=y

# # SNTP
# CONFIG_SNTP=y
# # CONFIG_SNTP_LOG_LEVEL_DBG=n

# Littlefs
CONFIG_FLASH=y
CONFIG_FLASH_MAP=y
CONFIG_FLASH_PAGE_LAYOUT=y

CONFIG_FILE_SYSTEM=y
CONFIG_FILE_SYSTEM_LITTLEFS=y

# RTC and alarm
CONFIG_RTC=y
CONFIG_RTC_ALARM=y
CONFIG_RTC_SHELL=y

# enable system file shell and need mem pool enable too
CONFIG_FILE_SYSTEM_SHELL=y
CONFIG_HEAP_MEM_POOL_SIZE=2048

CONFIG_SHELL=y
CONFIG_I2C_SHELL=y
CONFIG_SHELL_CMDS_SELECT=y
CONFIG_SHELL_START_OBSCURED=y
CONFIG_SHELL_PROMPT_UART="login: "
CONFIG_SHELL_CMD_ROOT="login"

# # Enable the MQTT Lib
# CONFIG_MQTT_LIB=y

# CONFIG_NET_MGMT_EVENT_STACK_SIZE=2048
# CONFIG_NET_MGMT_EVENT_QUEUE_SIZE=10
# CONFIG_NET_TCP_WORKQ_STACK_SIZE=2048

# # test.mosquitto.org
# CONFIG_MQTT_SERVICE_SERVER_DOMAIN_NAME="test.mosquitto.org"
# CONFIG_MQTT_SERVICE_SERVER_FALLBACK_IP_ADDRESS="91.121.93.94"
# CONFIG_MQTT_SERVICE_SERVER_PORT=1883
# CONFIG_MQTT_DEVICE_NAME="esp32"
```

## debug.conf
```kconfig
CONFIG_DEBUG=y

# CONFIG_LOG=y
# CONFIG_LOG_MODE_IMMEDIATE=y

# Zephyr RTOS plugin for JlinkGDBserver
CONFIG_DEBUG_THREAD_INFO=y
CONFIG_THREAD_NAME=y
CONFIG_TRACING=y
```

## src/main.c
```c
/**
 * @file    main.c
 * @brief
 */

//==============================================================================
// Includes
//==============================================================================

#include <zephyr/kernel.h>
#include <zephyr/drivers/gpio.h>
#include <zephyr/sys/util.h>

#include <string.h>
#include <stdio.h>
#include <stdlib.h>
#include <sys/types.h>

#define LED0 DT_ALIAS(led0)

const struct gpio_dt_spec g_led0 = GPIO_DT_SPEC_GET(LED0, gpios);

static int init_gpio(void);

static int init_gpio(void)
{
  int ret;

  ret = device_is_ready(g_led0.port);
  if (ret < 0)
  {
    printk("Device led0 nao inicializado!\r\n");
    return -1;
  }

  ret = gpio_pin_configure_dt(&g_led0, GPIO_OUTPUT_ACTIVE);
  if (ret < 0)
  {
    printk("Falha na configuracao do led0!\r\n");
    return -1;
  }

  return 0;
}

int main(void)
{
  init_gpio();
  printk(">> Project: ZPHR-STM32-0003 - v1.0.0<<\r\n");

  while (1)
  {
    // Toogle led
    gpio_pin_toggle_dt(&g_led0);

    k_msleep(300);
  }

  return 0;
}
```
